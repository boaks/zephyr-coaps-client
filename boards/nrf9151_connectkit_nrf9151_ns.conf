## extras/v3.3.x/circuitdojo/feather_nrf9151/board.yml
```yaml
board:
  name: circuitdojo_feather_nrf9151
  full_name: nRF9151 Feather
  vendor: circuitdojo
  socs:
    - name: nrf9151
      variants:
        - name: 'ns'
  revision:
    format: number
    default: "1"
    revisions:
      - name: "1"
```

## extras/v3.3.x/circuitdojo/feather_nrf9161/board.yml
```yaml
board:
  name: circuitdojo_feather_nrf9161
  full_name: nRF9161 Feather
  vendor: circuitdojo
  socs:
    - name: nrf9161
      variants:
        - name: ns
  revision:
    format: number
    default: "1"
    revisions:
      - name: "1"
```

## extras/v3.3.x/conexio/stratus_pro/board.yml
```yaml
board:
  name: conexio_stratus_pro
  vendor: conexio
  full_name: Conexio Stratus Pro nRF9151/61
  socs:
  - name: nrf9161
    variants:
    - name: 'ns'
  - name: nrf9151
    variants:
    - name: 'ns'
```

## extras/v3.4.x/makerdiary/nrf9151_connectkit/board.yml
```yaml
board:
  name: nrf9151_connectkit
  full_name: Makerdiary nRF9151 ConnectKit
  vendor: makerdiary
  socs:
    - name: nrf52820
    - name: nrf9151
      variants:
        - name: 'ns'
```
