/*
 * Copyright (c) 2026 Achim Kraus CloudCoap.net
 *
 * See the NOTICE file(s) distributed with this work for additional
 * information regarding copyright ownership.
 *
 * This program and the accompanying materials are made available under the
 * terms of the Eclipse Public License 2.0 which is available at
 * http: //www.eclipse.org/legal/epl-2.0
 *
 * SPDX-License-Identifier: EPL-2.0
 */

#include "../dts/nrf91_bootloader_partitions.dtsi"
#include "../dts/nrf91_sram_partitions.dtsi"

&uart0 {
    timer = <&timer2>;
};


/    {
	chosen {
		/* cleanup leftovers from partition mananger */
		/delete-property/ nordic,pm-ext-flash;
	};
};

