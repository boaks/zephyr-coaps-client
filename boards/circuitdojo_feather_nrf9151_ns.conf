## boards/circuitdojo_feather_nrf9151_ns.conf
```kconfig
#
# Copyright (c) 2025 Achim Kraus CloudCoap.net
#
# See the NOTICE file(s) distributed with this work for additional
# information regarding copyright ownership.
#
# This program and the accompanying materials are made available under the
# terms of the Eclipse Public License 2.0 which is available at
# http://www.eclipse.org/legal/epl-2.0
#
# SPDX-License-Identifier: EPL-2.0
#

CONFIG_LED=y
CONFIG_SENSOR=y
CONFIG_I2C=y

CONFIG_UART_RX_PULLDOWN=y

CONFIG_REGULATOR=y

#CONFIG_MFD=y
#CONFIG_NPM1300_CHARGER=y

CONFIG_LIS2DH=y
CONFIG_LIS2DH_MEASURE_TEMPERATURE=n
CONFIG_LIS2DH_OPER_MODE_LOW_POWER=y
#CONFIG_LIS2DH_ODR_RUNTIME=y
CONFIG_LIS2DH_ODR_1=y
CONFIG_LIS2DH_ACCEL_RANGE_2G=y
#CONFIG_LIS2DH_ACCEL_RANGE_8G=y
# swap NONE and GLOBAL_THREAD to enable MOTION_DETECTION 
CONFIG_LIS2DH_TRIGGER_NONE=y
#CONFIG_LIS2DH_TRIGGER_GLOBAL_THREAD=y

# GPS Antenna configuration
CONFIG_MODEM_ANTENNA=y
CONFIG_MODEM_ANTENNA_AT_COEX0="AT\%XCOEX0=1,1,1565,1586"
```

## boards/circuitdojo_feather_nrf9160_ns.conf
```kconfig
#
# Copyright (c) 2023 Achim Kraus CloudCoap.net
#
# See the NOTICE file(s) distributed with this work for additional
# information regarding copyright ownership.
#
# This program and the accompanying materials are made available under the
# terms of the Eclipse Public License 2.0 which is available at
# http://www.eclipse.org/legal/epl-2.0
#
# SPDX-License-Identifier: EPL-2.0
#

CONFIG_BOOTLOADER_MCUBOOT=y

CONFIG_GPIO=y
CONFIG_I2C=y
CONFIG_SPI=y
CONFIG_UART_RX_PULLDOWN=y

CONFIG_ADC=y
CONFIG_BATTERY_ADC=y

CONFIG_SENSOR=y

CONFIG_LIS2DH=y
CONFIG_LIS2DH_MEASURE_TEMPERATURE=n
CONFIG_LIS2DH_OPER_MODE_LOW_POWER=y
#CONFIG_LIS2DH_ODR_RUNTIME=y
CONFIG_LIS2DH_ODR_1=y
CONFIG_LIS2DH_ACCEL_RANGE_2G=y
#CONFIG_LIS2DH_ACCEL_RANGE_8G=y
# swap NONE and GLOBAL_THREAD to enable MOTION_DETECTION 
CONFIG_LIS2DH_TRIGGER_NONE=y
#CONFIG_LIS2DH_TRIGGER_GLOBAL_THREAD=y

# GPS Antenna configuration
CONFIG_MODEM_ANTENNA=y
CONFIG_MODEM_ANTENNA_AT_COEX0="AT\%XCOEX0=1,1,1565,1586"

# Enable SPI flash
CONFIG_SPI_NOR=y
CONFIG_SPI_NOR_FLASH_LAYOUT_PAGE_SIZE=4096
CONFIG_SPI_NOR_SFDP_RUNTIME=y

# Enable flash operations.
CONFIG_FLASH=y
CONFIG_FLASH_JESD216_API=y
CONFIG_FLASH_PAGE_LAYOUT=y
```

## boards/circuitdojo_feather_nrf9161_ns.conf
```kconfig
#
# Copyright (c) 2024 Achim Kraus CloudCoap.net
#
# See the NOTICE file(s) distributed with this work for additional
# information regarding copyright ownership.
#
# This program and the accompanying materials are made available under the
# terms of the Eclipse Public License 2.0 which is available at
# http://www.eclipse.org/legal/epl-2.0
#
# SPDX-License-Identifier: EPL-2.0
#

CONFIG_BOOTLOADER_MCUBOOT=y
CONFIG_LED=y
CONFIG_SENSOR=y
CONFIG_I2C=y

CONFIG_UART_RX_PULLDOWN=y

CONFIG_REGULATOR=y

#CONFIG_MFD=y
#CONFIG_NPM1300_CHARGER=y

CONFIG_LIS2DH=y
CONFIG_LIS2DH_MEASURE_TEMPERATURE=n
CONFIG_LIS2DH_OPER_MODE_LOW_POWER=y
#CONFIG_LIS2DH_ODR_RUNTIME=y
CONFIG_LIS2DH_ODR_1=y
CONFIG_LIS2DH_ACCEL_RANGE_2G=y
#CONFIG_LIS2DH_ACCEL_RANGE_8G=y
# swap NONE and GLOBAL_THREAD to enable MOTION_DETECTION 
CONFIG_LIS2DH_TRIGGER_NONE=y
#CONFIG_LIS2DH_TRIGGER_GLOBAL_THREAD=y
```

## boards/nrf9151dk_nrf9151_ns.conf
```kconfig
#
# Copyright (c) 2024 Achim Kraus CloudCoap.net
#
# See the NOTICE file(s) distributed with this work for additional
# information regarding copyright ownership.
#
# This program and the accompanying materials are made available under the
# terms of the Eclipse Public License 2.0 which is available at
# http://www.eclipse.org/legal/epl-2.0
#
# SPDX-License-Identifier: EPL-2.0
#

CONFIG_GPIO=y
CONFIG_LED=y
CONFIG_LED_GPIO=y

# Enable SPI flash
#CONFIG_SPI_NOR_FLASH_LAYOUT_PAGE_SIZE=65536
#CONFIG_SPI_NOR_SFDP_RUNTIME=y

#CONFIG_PM_OVERRIDE_EXTERNAL_DRIVER_CHECK=y
```

## boards/nrf9160dk_nrf9160_ns.conf
```kconfig
#
# Copyright (c) 2022 Achim Kraus CloudCoap.net
#
# See the NOTICE file(s) distributed with this work for additional
# information regarding copyright ownership.
#
# This program and the accompanying materials are made available under the
# terms of the Eclipse Public License 2.0 which is available at
# http://www.eclipse.org/legal/epl-2.0
#
# SPDX-License-Identifier: EPL-2.0
#

# CAF - Common Application Framework
CONFIG_GPIO=y
CONFIG_LED=y
CONFIG_LED_GPIO=y

CONFIG_SPI=y

# Enable SPI flash
# CONFIG_SPI_NOR_FLASH_LAYOUT_PAGE_SIZE=4096
# CONFIG_SPI_NOR_SFDP_RUNTIME=y
```

## boards/thingy91_nrf9160_ns.conf
```kconfig
#
# Copyright (c) 2022 Achim Kraus CloudCoap.net
#
# See the NOTICE file(s) distributed with this work for additional
# information regarding copyright ownership.
#
# This program and the accompanying materials are made available under the
# terms of the Eclipse Public License 2.0 which is available at
# http://www.eclipse.org/legal/epl-2.0
#
# SPDX-License-Identifier: EPL-2.0
#

# Configuration related to external sensors.
CONFIG_SENSOR=y

CONFIG_UART_RX_PULLDOWN=y

# ADXL362 - Accelerometer

#CONFIG_ADXL362_TRIGGER_GLOBAL_THREAD=y
CONFIG_ADXL362_INTERRUPT_MODE=1
CONFIG_ADXL362_ABS_REF_MODE=1
CONFIG_ADXL362_ACCEL_RANGE_2G=y
CONFIG_ADXL362_ACCEL_ODR_12_5=y
CONFIG_ADXL362_ACTIVITY_THRESHOLD=125
CONFIG_ADXL362_ACTIVITY_TIME=4

# CAF - Common Application Framework
# CONFIG_PWM=y
# CONFIG_LED_PWM=y
# CONFIG_CAF_LEDS_PWM=y

#CONFIG_EEPROM=y
#CONFIG_EEPROM_AT24=y
#CONFIG_EEPROM_INIT_PRIORITY=75
```

## boards/thingy91x_nrf9151_ns.conf
```kconfig
#
# Copyright (c) 2024 Achim Kraus CloudCoap.net
#
# See the NOTICE file(s) distributed with this work for additional
# information regarding copyright ownership.
#
# This program and the accompanying materials are made available under the
# terms of the Eclipse Public License 2.0 which is available at
# http://www.eclipse.org/legal/epl-2.0
#
# SPDX-License-Identifier: EPL-2.0
#

# Disabled for power saving
# CONFIG_SPI=n

CONFIG_UART_RX_PULLDOWN=y

# CONFIG_PM_PARTITION_REGION_SETTINGS_STORAGE_EXTERNAL=y

# CAF - Common Application Framework
# CONFIG_PWM=y
# CONFIG_LED_PWM=y
# CONFIG_CAF_LEDS_PWM=y

# Enable SPI flash
# CONFIG_SPI_NOR_SFDP_RUNTIME=y
# CONFIG_SPI_NOR_FLASH_LAYOUT_PAGE_SIZE=65536

#CONFIG_ADXL367_TRIGGER_GLOBAL_THREAD=y
CONFIG_ADXL367_ACTIVITY_THRESHOLD=125
CONFIG_ADXL367_ACTIVITY_TIME=0
CONFIG_ADXL367_ACTIVITY_DETECTION_MODE=y
CONFIG_ADXL367_REFERENCED_ACTIVITY_DETECTION_MODE=y
CONFIG_ADXL367_INACTIVITY_THRESHOLD=125
CONFIG_ADXL367_INACTIVITY_TIME=0
CONFIG_ADXL367_INACTIVITY_DETECTION_MODE=n
CONFIG_ADXL367_REFERENCED_INACTIVITY_DETECTION_MODE=n
```

## extras/circuitdojo_feather_nrf9161/Kconfig
```kconfig
# Circuit Dojo nRF9161 Feather configuration
#
# Copyright (c) 2020-2024 Circuit Dojo LLC
# SPDX-License-Identifier: Apache-2.0

config CIRCUITDOJO_FEATHER_NRF9161_PMIC_STARTUP
	bool "Allows for executing startup code for PMIC."
```

## extras/conexio_stratus_pro/Kconfig.board
```kconfig
# CONEXIO STRATUS PRO board configuration

# Copyright (c) 2024 Conexio Technologies, Inc
# Copyright (c) 2018-2020 Nordic Semiconductor ASA
# SPDX-License-Identifier: Apache-2.0

if SOC_NRF9161_LACA

config BOARD_CONEXIO_STRATUS_PRO
	bool "Conexio Stratus Pro"

config BOARD_CONEXIO_STRATUS_PRO_NS
	bool "Conexio Stratus Pro non-secure"

endif # SOC_NRF9161_LACA
```

## extras/conexio_stratus_pro/Kconfig.defconfig
```kconfig
# CONEXIO STRATUS PRO board configuration
#
# Copyright (c) 2024 Conexio Technologies, Inc
# SPDX-License-Identifier: Apache-2.0

rsource "Kconfig.defconfig.nrf9151"
rsource "Kconfig.defconfig.nrf9161"
```

## extras/v2.6.2/circuitdojo_feather_nrf9161/Kconfig.board
```kconfig
# Circuit Dojo nRF9161 Feather configuration

# Copyright (c) 2018-2024 Nordic Semiconductor ASA
# Copyright (c) 2020-2024 Circuit Dojo LLC
# SPDX-License-Identifier: Apache-2.0

if SOC_NRF9161_LACA

config BOARD_CIRCUITDOJO_FEATHER_NRF9161
	bool "Circuit Dojo nRF9161 Feather"

config BOARD_CIRCUITDOJO_FEATHER_NRF9161_NS
	bool "Circuit Dojo nRF9161 Feather non-secure"

endif # SOC_NRF9161_LACA
```

## extras/v2.6.2/circuitdojo_feather_nrf9161/circuitdojo_feather_nrf9161_ns_defconfig
```kconfig
# SPDX-License-Identifier: Apache-2.0

CONFIG_SOC_SERIES_NRF91X=y
CONFIG_SOC_NRF9161_LACA=y
CONFIG_BOARD_CIRCUITDOJO_FEATHER_NRF9161_NS=y

# Enable MPU
CONFIG_ARM_MPU=y

# Enable TrustZone-M
CONFIG_ARM_TRUSTZONE_M=y

# This Board implies building Non-Secure firmware
CONFIG_TRUSTED_EXECUTION_NONSECURE=y

# Hardware stack protection
CONFIG_HW_STACK_PROTECTION=y

# Enable GPIO
CONFIG_GPIO=y

# Enable uart driver
CONFIG_SERIAL=y

# Enable console
CONFIG_CONSOLE=y
CONFIG_UART_CONSOLE=y

# Enable pincontrol
CONFIG_PINCTRL=y

# Disable entropy driver, as it's not yet implemented
CONFIG_ENTROPY_NRF5_RNG=n
```

## extras/v2.6.2/conexio_stratus_pro/Kconfig.board
```kconfig
# CONEXIO STRATUS PRO board configuration

# Copyright (c) 2024 Conexio Technologies, Inc
# Copyright (c) 2018-2020 Nordic Semiconductor ASA
# SPDX-License-Identifier: Apache-2.0

if SOC_NRF9161_LACA

config BOARD_CONEXIO_STRATUS_PRO_NRF9161
	bool "Conexio Stratus Pro nRF9161"

config BOARD_CONEXIO_STRATUS_PRO_NRF9161_NS
	bool "Conexio Stratus Pro nRF9161 non-secure"

endif # SOC_NRF9161_LACA

if SOC_NRF9151_LACA

config BOARD_CONEXIO_STRATUS_PRO_NRF9151
	bool "Conexio Stratus Pro nRF9151"

config BOARD_CONEXIO_STRATUS_PRO_NRF9151_NS
	bool "Conexio Stratus Pro nRF9151 non-secure"

endif # SOC_NRF9151_LACA
```

## extras/v2.6.x/conexio_stratus_pro/Kconfig.conexio_stratus_pro
```kconfig
# CONEXIO STRATUS PRO board configuration
#
# Copyright (c) 2024 Conexio Technologies, Inc
# SPDX-License-Identifier: Apache-2.0

config BOARD_CONEXIO_STRATUS_PRO
	select SOC_NRF9161_LACA if BOARD_CONEXIO_STRATUS_PRO_NRF9161 || BOARD_CONEXIO_STRATUS_PRO_NRF9161_NS
	select SOC_NRF9151_LACA if BOARD_CONEXIO_STRATUS_PRO_NRF9151 || BOARD_CONEXIO_STRATUS_PRO_NRF9151_NS
```

## extras/v2.9.x/circuitdojo/feather_nrf9151/Kconfig
```kconfig
config CIRCUITDOJO_FEATHER_NRF9151_STATIC_PARTITIONS_FACTORY
    bool "Use the static parition defintitions to stay compatible with bootloader"
    default y

if !MCUBOOT
config CIRCUITDOJO_FEATHER_NRF9151_PMIC_STARTUP
	bool "Allows for executing startup code for PMIC."
	default y
endif
```

## extras/v3.1.x/conexio/stratus_pro/board.yml
```yaml
board:
  name: conexio_stratus_pro
  vendor: conexio
  socs:
  - name: nrf9161
    variants:
    - name: 'ns'
  - name: nrf9151
    variants:
    - name: 'ns'
```

## extras/v3.4.x/circuitdojo/feather_nrf9161/circuitdojo_feather_nrf9161_defconfig
```kconfig
# SPDX-License-Identifier: Apache-2.0

# Enable MPU
CONFIG_ARM_MPU=y

# Hardware stack protection
CONFIG_HW_STACK_PROTECTION=y

# Enable TrustZone-M
CONFIG_ARM_TRUSTZONE_M=y

# Enable GPIO
CONFIG_GPIO=y

# Enable uart driver
CONFIG_SERIAL=y

# Enable console
CONFIG_CONSOLE=y
CONFIG_UART_CONSOLE=y

# Enable pincontrol
CONFIG_PINCTRL=y

# Disable entropy driver, as it's not yet implemented
CONFIG_ENTROPY_NRF5_RNG=n
```

## src/ext_sensors/Kconfig
```kconfig
#
# Copyright (c) 2021 Nordic Semiconductor
#
# SPDX-License-Identifier: LicenseRef-Nordic-5-Clause
#
# Origin:
# https://github.com/nrfconnect/sdk-nrf/blob/v1.9.1/applications/asset_tracker_v2/src/ext_sensors/KConfig

menuconfig EXTERNAL_SENSORS
	bool "External sensors"

if EXTERNAL_SENSORS

config EXTERNAL_SENSORS_ACTIVITY_DETECTION_AUTO
	bool "Start activity detection automatically"
	help
	  Enable this option to start activity detection when the library is initialized.
	  If the option is disabled, the accelerometer trigger handler must manually be enabled to
	  detect activity.

module = EXTERNAL_SENSORS
module-str = External sensors
source "${ZEPHYR_BASE}/subsys/logging/Kconfig.template.log_config"

endif # EXTERNAL_SENSORS
```

## sysbuild/mcuboot/boards/conexio_stratus_pro_nrf9151.conf
```kconfig
#
# Copyright (c) 2025 Achim Kraus CloudCoap.net
#
# See the NOTICE file(s) distributed with this work for additional
# information regarding copyright ownership.
#
# This program and the accompanying materials are made available under the
# terms of the Eclipse Public License 2.0 which is available at
# http://www.eclipse.org/legal/epl-2.0
#
# SPDX-License-Identifier: EPL-2.0
#

# Disable Zephyr console
CONFIG_CONSOLE=n
CONFIG_CONSOLE_HANDLER=n
CONFIG_UART_CONSOLE=n

# Multithreading
CONFIG_MULTITHREADING=y

# MCUBoot settings
CONFIG_BOOT_MAX_IMG_SECTORS=256

# MCUboot serial recovery
CONFIG_MCUBOOT_SERIAL=y
CONFIG_MCUBOOT_INDICATION_LED=y
```

## sysbuild/mcuboot/boards/thingy91x_nrf9151.conf
```kconfig
#
# Copyright (c) 2025 Achim Kraus CloudCoap.net
#
# See the NOTICE file(s) distributed with this work for additional
# information regarding copyright ownership.
#
# This program and the accompanying materials are made available under the
# terms of the Eclipse Public License 2.0 which is available at
# http://www.eclipse.org/legal/epl-2.0
#
# SPDX-License-Identifier: EPL-2.0
#

# MCUBoot settings
CONFIG_BOOT_MAX_IMG_SECTORS=512

CONFIG_SPI=y
CONFIG_SPI_NOR=y
CONFIG_SPI_NOR_FLASH_LAYOUT_PAGE_SIZE=4096
CONFIG_SPI_NOR_SFDP_DEVICETREE=y
CONFIG_MULTITHREADING=y

# Disable Zephyr console and use UART for MCUboot serial recovery instead
CONFIG_CONSOLE=n
CONFIG_CONSOLE_HANDLER=n
CONFIG_UART_CONSOLE=n
CONFIG_MCUBOOT_SERIAL=y
CONFIG_MCUBOOT_SERIAL_DIRECT_IMAGE_UPLOAD=y
CONFIG_BOOT_SERIAL_IMG_GRP_IMAGE_STATE=y

CONFIG_PM_EXTERNAL_FLASH_MCUBOOT_SECONDARY=y
CONFIG_PM_OVERRIDE_EXTERNAL_DRIVER_CHECK=y

CONFIG_FW_INFO_FIRMWARE_VERSION=2
```
