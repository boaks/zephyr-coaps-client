/*
 * Copyright (c) 2025 Achim Kraus CloudCoap.net
 *
 * See the NOTICE file(s) distributed with this work for additional
 * information regarding copyright ownership.
 *
 * This program and the accompanying materials are made available under the
 * terms of the Eclipse Public License 2.0 which is available at
 * http: //www.eclipse.org/legal/epl-2.0
 *
 * SPDX-License-Identifier: EPL-2.0
 */

&flash_ext {
	status = "okay";
};

/ {
	aliases {
		ext-flash = &flash_ext;
	};

	/* Configure partition manager to use gd25le255 as the external flash */
	chosen {
		nordic,pm-ext-flash = &flash_ext;
	};
};
