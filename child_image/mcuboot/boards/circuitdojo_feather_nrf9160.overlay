/*
 * Copyright (c) 2023 Achim Kraus CloudCoap.net
 *
 * See the NOTICE file(s) distributed with this work for additional
 * information regarding copyright ownership.
 *
 * This program and the accompanying materials are made available under the
 * terms of the Eclipse Public License 2.0 which is available at
 * http://www.eclipse.org/legal/epl-2.0
 *
 * SPDX-License-Identifier: EPL-2.0
 */

/ {

	leds {
		blue_led: led_0 {
			/* changed in v5 */
			gpios = <&gpio0 3 GPIO_ACTIVE_HIGH>;
		};
	};	
};

&uart0 {
	current-speed = <115200>;
};
