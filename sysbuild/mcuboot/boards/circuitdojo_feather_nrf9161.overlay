/*
 * Copyright (c) 2023 Achim Kraus CloudCoap.net
 *
 * See the NOTICE file(s) distributed with this work for additional
 * information regarding copyright ownership.
 *
 * This program and the accompanying materials are made available under the
 * terms of the Eclipse Public License 2.0 which is available at
 * http://www.eclipse.org/legal/epl-2.0
 *
 * SPDX-License-Identifier: EPL-2.0
 */

#include "../../../boards/circuitdojo_feather_nrf9161_ns.overlay"

/ {
	chosen {
		zephyr,code-partition = &boot_partition;
	};
};

&uart0 {
	current-speed = <115200>;
};
